## drivers/input/Kconfig
```kconfig
# Copyright (c) 2022 The ZMK Contributors
# SPDX-License-Identifier: MIT

menuconfig INPUT_PINNACLE
    bool "Cirque Pinnacle trackpads"
    default y
    depends on GPIO
    depends on SPI || I2C
    depends on INPUT
    depends on DT_HAS_CIRQUE_PINNACLE_ENABLED
    help
      Enable driver for Cirque Pinnacle trackpads

if INPUT_PINNACLE

config INPUT_PINNACLE_INIT_PRIORITY
    int "Cirque Pinnacle initialization priority"
    default INPUT_INIT_PRIORITY

if ZMK_MOUSE

config ZMK_INPUT_PINNACLE_IDLE_SLEEPER
    bool "Pinnacle Sleep linked to ZMK idle state"
    default n

endif

endif
```

## dts/bindings/input/cirque,pinnacle-common.yaml
```yaml
properties:
  dr-gpios:
    type: phandle-array
    description: Data ready pin for the trackpad
  rotate-90:
    type: boolean
  x-invert:
    type: boolean
  y-invert:
    type: boolean
  sleep:
    type: boolean
  no-secondary-tap:
    type: boolean
  no-taps:
    type: boolean
  sensitivity:
    type: string
    enum:
      - 1x
      - 2x
      - 3x
      - 4x
    description: ADC attenuation (sensitivity) setting.
  x-axis-z-min:
    type: int
    default: 5
  y-axis-z-min:
    type: int
    default: 4
  absolute-mode:
    type: boolean
  absolute-mode-scale-to-width:
    type: int
    default: 1024
    description: Scale reported x values to [0-1024]
  absolute-mode-scale-to-height:
    type: int
    default: 1024
    description: Scale reported y values to [0-1024]
  absolute-mode-clamp-min-x:
    type: int
    default: 128
    description: |
      Specification says that active reporting of absolute position
      is: 128 ≤ X ≤1920 and 64 ≤ Y ≤ 1472, but on my touchpad, I need other values.
  absolute-mode-clamp-max-x:
    type: int
    default: 1920
    description: |
      Specification says that active reporting of absolute position
      is: 128 ≤ X ≤1920 and 64 ≤ Y ≤ 1472, but on my touchpad, I need other values.
  absolute-mode-clamp-min-y:
    type: int
    default: 64
    description: |
      Specification says that active reporting of absolute position
      is: 128 ≤ X ≤1920 and 64 ≤ Y ≤ 1472, but on my touchpad, I need other values.
  absolute-mode-clamp-max-y:
    type: int
    default: 1472
    description: |
      Specification says that active reporting of absolute position
      is: 128 ≤ X ≤1920 and 64 ≤ Y ≤ 1472, but on my touchpad, I need other values.
```
